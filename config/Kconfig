## config/Kconfig
```kconfig
config CHARY_SPLIT_BOND_RECOVERY
    bool
    default y if SHIELD_CHARY_LEFT || SHIELD_CHARY_RIGHT || SHIELD_CHARY_DONGLE
    depends on ZMK_SPLIT && BT_SMP
    help
      Recover a mismatched split bond when Zephyr reports that the peer no
      longer has the corresponding encryption key. Only the failed peer bond
      is removed; the connection is then re-established and paired normally.

config CHARY_FORCE_LEGACY_SPLIT_PAIRING
    bool
    default y if (SHIELD_CHARY_LEFT || SHIELD_CHARY_RIGHT || SHIELD_CHARY_DONGLE) && ZMK_BLE
    depends on BT && BT_SMP
    help
      Use BLE legacy Just Works pairing for the internal split link. This
      avoids the ECDH Secure Connections path, which stalls indefinitely on
      the affected dongle controller and ends in supervision timeout 0x08.

config CHARY_DONGLE_USB_PRIORITY
    bool
    default y if SHIELD_CHARY_DONGLE && ZMK_SPLIT_ROLE_CENTRAL
    depends on ZMK_USB && ZMK_BLE
    help
      Always route HID reports over USB while the dongle USB interface is
      ready. The BLE stack remains enabled for the internal split links, but a
      saved or automatically reconnected host BLE profile cannot take output
      away from the dongle's USB connection.

config CHARY_SKIP_SPLIT_LAYOUT_SYNC
    bool
    default y if SHIELD_CHARY_DONGLE && ZMK_SPLIT_ROLE_CENTRAL
    depends on ZMK_SPLIT && ZMK_SPLIT_ROLE_CENTRAL
    help
      Do not send the selected physical layout to split peripherals. Chary46
      has one fixed physical layout and Studio is disabled, while this unused
      write stalls the affected legacy-paired links until supervision timeout.

config CHARY_SPLIT_PERIPHERAL_RECOVERY
    bool "Recover a split peripheral after a lost connection"
    default y if SHIELD_CHARY_LEFT || SHIELD_CHARY_RIGHT
    depends on ZMK_SPLIT && !ZMK_SPLIT_ROLE_CENTRAL
    help
      Reboot a peripheral if a previously working split connection does not
      return within CHARY_SPLIT_PERIPHERAL_RECOVERY_TIMEOUT seconds. The
      recovery is armed only after the peripheral has connected once since
      boot, so an unavailable dongle cannot cause a reboot loop.

config CHARY_SPLIT_PERIPHERAL_RECOVERY_TIMEOUT
    int "Lost split connection recovery timeout (seconds)"
    default 8
    range 5 600
    depends on CHARY_SPLIT_PERIPHERAL_RECOVERY
    help
      How long a peripheral waits for normal Bluetooth reconnection before
      performing the cold reboot that would otherwise require pressing the
      controller reset button.
```

## config/boards/shields/chary/Kconfig.defconfig
```kconfig
# Copyright (c) 2022 Duccio Breschi
# SPDX-License-Identifier: MIT

if SHIELD_CHARY_RIGHT

config ZMK_KEYBOARD_NAME
    default "Chary"

endif

if SHIELD_CHARY_LEFT || SHIELD_CHARY_RIGHT

config ZMK_SPLIT
    default y

endif
```

## config/boards/shields/chary/Kconfig.shield
```kconfig
# Copyright (c) 2022 Duccio Breschi
# SPDX-License-Identifier: MIT

config SHIELD_CHARY_LEFT
    def_bool $(shields_list_contains,chary_left)

config SHIELD_CHARY_RIGHT
    def_bool $(shields_list_contains,chary_right)

config SHIELD_CHARY_DONGLE
    def_bool $(shields_list_contains,chary_dongle)
```

## config/west.yml
```yaml
manifest:
  remotes:
    - name: zephyrproject-rtos
      url-base: https://github.com/zephyrproject-rtos
    - name: zmkfirmware
      url-base: https://github.com/zmkfirmware
    - name: badjeff
      url-base: https://github.com/badjeff
  projects:
    - name: zephyr
      remote: zmkfirmware
      revision: 0fa4cc26d8b1e5243570ccc0f7f66c4c428d2961
      import:
        name-blocklist:
          - ci-tools
          - hal_altera
          - hal_cypress
          - hal_infineon
          - hal_microchip
          - hal_nxp
          - hal_openisa
          - hal_silabs
          - hal_xtensa
          - hal_st
          - hal_ti
          - loramac-node
          - mcuboot
          - mcumgr
          - net-tools
          - openthread
          - edtt
          - trusted-firmware-m
    - name: zmk
      remote: zmkfirmware
      revision: ad6a181d7ec34fb6e31134f6bb991a9b2d0b8f78
      import: app/west.yml
    - name: zmk-pmw3610-driver
      remote: badjeff
      revision: 5c5af40de4d8cdf55dc63c4c5907af1e52da6a95
  self:
    path: config
```
